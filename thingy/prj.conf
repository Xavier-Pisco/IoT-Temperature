## prj.conf
```kconfig
CONFIG_USE_SEGGER_RTT=y
CONFIG_RTT_CONSOLE=y

CONFIG_BT=y
CONFIG_BT_DEBUG_LOG=y
CONFIG_BT_SMP=y
CONFIG_BT_PERIPHERAL=y
CONFIG_BT_DIS=y
CONFIG_BT_DIS_PNP=n
CONFIG_BT_BAS=y
CONFIG_I2C=y
CONFIG_BT_DEVICE_NAME="iot_group_3_xavier"
CONFIG_BT_DEVICE_NAME_DYNAMIC=y
CONFIG_BT_DEVICE_APPEARANCE=768
CONFIG_BT_ATT_ENFORCE_FLOW=n
```

## src/main.c
```c
// Common includes
#include <stddef.h>
#include <stdio.h>
#include <string.h>
#include <zephyr/kernel.h>
#include <zephyr/sys/printk.h>
#include <zephyr/sys/util.h>
#include <zephyr/types.h>

#include "bt.h"
#include "led.h"
#include "sensor.h"

void main(void) {
  if (init_leds()) {
    printk("Couldn't initialize leds. Continuing...\n");
  }

  if (init_sensor()) {
    printk("Couldn't initialize temperature sensor. Exiting.\n");
    return;
  }

  if (init_bluetooth()) {
    printk("Couldn't initialize bluetooth. Exiting.\n");
    return;
  }
  red();

  while (1) {
    notify_temperature();

    k_sleep(K_SECONDS(1));
  }
}
```

## src/bt.c
```c
#include <zephyr/bluetooth/bluetooth.h>
#include <zephyr/bluetooth/conn.h>
#include <zephyr/bluetooth/gatt.h>
#include <zephyr/bluetooth/hci.h>
#include <zephyr/bluetooth/uuid.h>
#include <zephyr/sys/byteorder.h>

#include "led.h"

#define DEVICE_NAME CONFIG_BT_DEVICE_NAME
#define DEVICE_NAME_LEN (sizeof(DEVICE_NAME) - 1)
#define BT_UUID_HTS_INTERMEDIATE BT_UUID_DECLARE_16(0x2a1e)

static uint8_t data[5];
static struct bt_gatt_indicate_params ind_params;
BT_GATT_SERVICE_DEFINE(
    hts_svc, BT_GATT_PRIMARY_SERVICE(BT_UUID_HTS),
    // Notification for Intermediate temperature
    BT_GATT_CHARACTERISTIC(BT_UUID_HTS_INTERMEDIATE, BT_GATT_CHRC_NOTIFY,
                           BT_GATT_PERM_READ, NULL, NULL, NULL),
    BT_GATT_CCC(NULL, BT_GATT_PERM_READ | BT_GATT_PERM_WRITE),
    // Indicate for temperature measurement
    BT_GATT_CHARACTERISTIC(BT_UUID_HTS_MEASUREMENT, BT_GATT_CHRC_INDICATE,
                           BT_GATT_PERM_READ, NULL, NULL, NULL),
    BT_GATT_CCC(NULL, BT_GATT_PERM_READ | BT_GATT_PERM_WRITE), );

/**
 * Data to advertise in the advertisement packets
 */
static const struct bt_data ad[] = {
    BT_DATA_BYTES(BT_DATA_FLAGS, BT_LE_AD_GENERAL),
    BT_DATA_BYTES(
        BT_DATA_UUID16_ALL,
        BT_UUID_16_ENCODE(
            BT_UUID_HTS_VAL)), // Advertising Health Termometer Service
};

/* Data to scan in response packets */
static const struct bt_data sd[] = {
    BT_DATA(BT_DATA_NAME_COMPLETE, DEVICE_NAME,
            DEVICE_NAME_LEN), // Scanning name of device
};

/**
 * Initializes the bluetoothe device and starts advertisement
 */
static void bt_ready(int err) {
  char addr_s[BT_ADDR_LE_STR_LEN];
  bt_addr_le_t addr = {0};
  size_t count = 1;

  if (err) {
    printk("Bluetooth init failed (err %d)\n", err);
    return;
  }

  printk("Bluetooth initialized\n");

  /* Start advertising */
  err = bt_le_adv_start(BT_LE_ADV_CONN, ad, ARRAY_SIZE(ad), sd, ARRAY_SIZE(sd));
  if (err) {
    printk("Advertising failed to start (err %d)\n", err);
    return;
  }

  bt_id_get(&addr, &count);
  bt_addr_le_to_str(&addr, addr_s, sizeof(addr_s));

  printk("Beacon started, advertising as %s\n", addr_s);
}

/**
 * Callback called when a device is connected
 * Changes the light of the led to green
 *
 * @param conn Connection that was estabilished
 * @param err 0 if there was no error other value otherwise
 */
static void connected(struct bt_conn *conn, uint8_t err) {
  if (err) {
    printk("Error connecting (err %d)\n", err);
  }

  printk("Connected\n");
  green();
}

/**
 * Callback called when a device is disconnected
 * Changes the light of the led to red
 *
 * @param conn Connection that was removed
 * @param reason Reson for disconnecting
 */
static void disconnected(struct bt_conn *conn, uint8_t reason) {
  printk("Disconnected with reason %d\n", reason);
  red();
}

static struct bt_conn_cb conn_callbacks = {
    .connected = connected,
    .disconnected = disconnected,
};

/**
 * Updates the data array based on the available temperature from the sensor
*/
void update_data() {
  uint32_t mantissa;
  uint8_t exponent;
  extern double temperature;

  mantissa = (uint32_t)(temperature * 100);
  exponent = (uint8_t)-2;

  data[0] = 0; /* temperature in celsius */
  sys_put_le24(mantissa, (uint8_t *)&data[1]);
  data[4] = exponent;
}

/**
 * Send a notification with the current temperature
 */
void notify_temperature() {
  update_data();
  bt_gatt_notify(NULL, &hts_svc.attrs[1], data, sizeof(data));
  printk("Notified temperature.\n");
}

/**
 * Indicates the current temperature
 */
void indicate_temperature() {
  update_data();
  ind_params.attr = &hts_svc.attrs[4];
  ind_params.data = &data;
  ind_params.len = sizeof(data);
  bt_gatt_indicate(NULL, &ind_params);
  printk("Indicated temperature.\n");
}

int init_bluetooth() {
  // Initialize the bluetooth device
  int err = bt_enable(bt_ready);
  if (err) {
    printk("Bluetooth init failed (err %d)\n", err);
    return -1;
  }

  // Register the callback functions for bluetooth
  bt_conn_cb_register(&conn_callbacks);
  return 0;
}
```

## src/bt.h
```c
#ifndef bt_h
#define bt_h

/**
 * Sends a notification via bluetooth with the temperature
 */
void notify_temperature();
/**
 * Indicates the temperature via bluetooth
 */
void indicate_temperature();
/**
 * Initialize bluetooth device and wait for connections
 */
int init_bluetooth();

#endif
```

## src/led.c
```c
#include <zephyr/drivers/gpio.h>

#define LED0_NODE DT_NODELABEL(led0)
#define LED1_NODE DT_NODELABEL(led1)

static const struct gpio_dt_spec redLed = GPIO_DT_SPEC_GET(LED0_NODE, gpios);
static const struct gpio_dt_spec greenLed = GPIO_DT_SPEC_GET(LED1_NODE, gpios);

void green() {
  gpio_pin_set_dt(&greenLed, 1);
  gpio_pin_set_dt(&redLed, 0);
}

void red() {
  gpio_pin_set_dt(&greenLed, 0);
  gpio_pin_set_dt(&redLed, 1);
}

int init_leds() {
  if (!device_is_ready(redLed.port) || !device_is_ready(greenLed.port)) {
    return -1;
  }
  if (gpio_pin_configure_dt(&redLed, GPIO_OUTPUT_INACTIVE) < 0 ||
      gpio_pin_configure_dt(&greenLed, GPIO_OUTPUT_INACTIVE) < 0) {
    return -1;
  }
  return 0;
}
```

## src/led.h
```c
#ifndef led_h
#define led_h

/**
 * Set the led to green
*/
void green();
/**
 * Sets the led to red
*/
void red();
/**
 * Initializes the leds
*/
int init_leds();

#endif
```

## src/sensor.c
```c
#include "bt.h"
#include <zephyr/drivers/sensor.h>
#include <zephyr/sys/printk.h>

static const struct device *temp_dev = DEVICE_DT_GET_ONE(st_hts221);
double temperature;

/**
 * Read the temperature from the sensor into a global variable
*/
static void get_temperature(const struct device *dev,
                            const struct sensor_trigger *trig) {
  struct sensor_value temp;
  if (sensor_sample_fetch(dev) < 0) {
    printk("Sensor sample update error\n");
    return;
  }

  if (sensor_channel_get(dev, SENSOR_CHAN_AMBIENT_TEMP, &temp) < 0) {
    printk("Cannot read HTS221 temperature channel\n");
    return;
  }

  temperature = sensor_value_to_double(&temp);

  printk("Temperature is approximately %dC\n", (int)temperature);

  indicate_temperature();
}

/**
 * Initializes the hts221 sensor
*/
int init_sensor() {
  if (!device_is_ready(temp_dev)) {
    return -1;
  }

  // Activates sensor trigger when there is new data to read
  if (IS_ENABLED(CONFIG_HTS221_TRIGGER)) {
    struct sensor_trigger trig = {
        .type = SENSOR_TRIG_DATA_READY,
        .chan = SENSOR_CHAN_ALL,
    };
    // Add the callback function to the trigger
    if (sensor_trigger_set(temp_dev, &trig, get_temperature) < 0) {
      return -1;
    }
  }

  return 0;
}
```

## src/sensor.h
```c
#ifndef sensor_h
#define sensor_h

/**
 * Initializes the temperature sensor
 */
int init_sensor();

#endif
```
